/* Copyright (c) 2018, The Linux Foundation. All rights reserved.
 * Copyright (C) 2021 XiaoMi, Inc.
 *
 * This program is free software; you can redistribute it and/or modify
 * it under the terms of the GNU General Public License version 2 and
 * only version 2 as published by the Free Software Foundation.
 *
 * This program is distributed in the hope that it will be useful,
 * but WITHOUT ANY WARRANTY; without even the implied warranty of
 * MERCHANTABILITY or FITNESS FOR A PARTICULAR PURPOSE.  See the
 * GNU General Public License for more details.
 */

/* Standalone DTB for Xiaomi Redmi Note 10 Pro (sweet).
 * Combines xiaomi-sdmmagpie base with sweet-specific hardware.
 * board-id <46 0> / msm-id <365 0x0> matches the sweet bootloader.
 */

/dts-v1/;

#include "sdmmagpie.dtsi"
#include "xiaomi/pm6150.dtsi"
#include "xiaomi/pm6150l.dtsi"
#include "xiaomi/sdmmagpie.dtsi"
#include "xiaomi/sdmmagpie-camera.dtsi"
#include "xiaomi/sdmmagpie-pinctrl.dtsi"
#include "xiaomi/sdmmagpie-regulator.dtsi"
#include "xiaomi/sdmmagpie-sde.dtsi"
#include "xiaomi/sdmmagpie-thermal.dtsi"
#include "xiaomi/sweet/sweet-audio-overlay.dtsi"
#include "xiaomi/sweet/sweet-sdmmagpie.dtsi"
#include "xiaomi/sweet/sweet-nfc-overlay.dtsi"

/ {
	model = "Xiaomi Redmi Note 10 Pro";
	compatible = "qcom,sdmmagpie-qrd", "qcom,sdmmagpie", "qcom,qrd";
	qcom,msm-id = <365 0x0>;
	/* board-id <0 0> = wildcard, so the bootloader (ABL) always accepts
	 * this DTB (like the stock base xiaomi-sdmmagpie.dtb). The real sweet
	 * variant id <46> made ABL reject the single embedded DTB and drop to
	 * fastboot; the sweet-specific hardware comes from the includes below. */
	qcom,board-id = <0 0>;
	qcom,pmic-name = "PM6150";
};

&pm6150l_lcdb {
	/delete-property/ qcom,voltage-step-ramp;
};

&sm6150_snd {
	/delete-property/ fsa4480-i2c-handle;
};

&icnss {
	/delete-property/ vdd-3.3-ch1-supply;
};
